// SPDX-License-Identifier: (GPL-2.0+ OR BSD-3-Clause)
/*
 * Xiaomi POCO X5 Pro 5G (redwood), variant with FocalTech FT3680 touch.
 * Redwood ships with either a Goodix Berlin-D or a FocalTech FT3680 controller
 * (downstream lists both on the same SPI bus).
 */

#include "sm7325-xiaomi-redwood.dts"

&touchscreen {
	compatible = "focaltech,fts_ts";

	/delete-property/ interrupts-extended;
	/delete-property/ reset-gpios;
	/delete-property/ avdd-supply;
	/delete-property/ vddio-supply;

	interrupts-extended = <&tlmm 81 IRQ_TYPE_EDGE_FALLING>;
	/* the vendor driver drives reset as a raw level, same as nothing-spacewar */
	reset-gpios = <&tlmm 105 GPIO_ACTIVE_HIGH>;
	focaltech,irq-gpio = <&tlmm 81 GPIO_ACTIVE_LOW>;
	/* Xiaomi "super resolution" reports: 10x coordinates (vendor DT) */
	focaltech,super-resolution-factors = <10>;
	focaltech,display-coords = <0 0 10800 24000>;
	focaltech,max-touch-number = <10>;
	/* FT3680 is flashless: Xiaomi firmware is loaded into its RAM at every boot */
	firmware-name = "focaltech_ts_fw_m20.bin";

	vdd-supply = <&vreg_ts_avdd>;
	iovdd-supply = <&vreg_l2c_1p8>;
};
